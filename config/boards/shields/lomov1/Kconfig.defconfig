## config/west.yml
```yaml
manifest:
  remotes:
    - name: klouderone
      url-base: https://github.com/zmkfirmware
  projects:
    - name: zmk
      remote: klouderone
      revision: main
      import: app/west.yml
  self:
    path: config
```
