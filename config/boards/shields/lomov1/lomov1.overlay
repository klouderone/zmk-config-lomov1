#include <dt-bindings/zmk/matrix_transform.h>

/ {
    chosen {
        zmk,kscan = &kscan0;
    };

    kscan0: kscan {
        compatible = "zmk,kscan-gpio-direct";
        label = "KSCAN";

        input-gpios =
            <&pro_micro 20 (GPIO_ACTIVE_LOW | GPIO_PULL_UP)>,
            <&pro_micro 18 (GPIO_ACTIVE_LOW | GPIO_PULL_UP)>,
            <&pro_micro 14 (GPIO_ACTIVE_LOW | GPIO_PULL_UP)>,
            <&pro_micro 21 (GPIO_ACTIVE_LOW | GPIO_PULL_UP)>,
            <&pro_micro 19 (GPIO_ACTIVE_LOW | GPIO_PULL_UP)>,
            <&pro_micro 15 (GPIO_ACTIVE_LOW | GPIO_PULL_UP)>,
            <&pro_micro 10 (GPIO_ACTIVE_LOW | GPIO_PULL_UP)>,
            <&pro_micro 16 (GPIO_ACTIVE_LOW | GPIO_PULL_UP)>;
    };
};

`